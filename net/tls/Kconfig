## net/tls/Kconfig
```kconfig
# SPDX-License-Identifier: GPL-2.0-only
#
# TLS configuration
#
config TLS
	tristate "Transport Layer Security support"
	depends on INET
	select CRYPTO
	select CRYPTO_AES
	select CRYPTO_GCM
	select STREAM_PARSER
	select NET_SOCK_MSG
	default n
	help
	Enable kernel support for TLS protocol. This allows symmetric
	encryption handling of the TLS protocol to be done in-kernel.

	If unsure, say N.

config TLS_DEVICE
	bool "Transport Layer Security HW offload"
	depends on TLS
	select SOCK_VALIDATE_XMIT
	default n
	help
	Enable kernel support for HW offload of the TLS protocol.

	If unsure, say N.

config TLS_TOE
	bool "Transport Layer Security TCP stack bypass"
	depends on TLS
	default n
	help
	Enable kernel support for legacy HW offload of the TLS protocol,
	which is incompatible with the Linux networking stack semantics.

	If unsure, say N.

config TLS_SOFTIRQ
	bool "Process TLS in softirq context"
	depends on TLS
	default n
	help
	By default kTLS works in socket context, so it constructs TLS records of
	maximum size or of size of available data. The TLS records formed in
	this way may exceed size of currently allowed transmission on TCP layer
	leading to extra delays in TLS decryption on receive side.

	Traditionally, the problem is associated with TCP slow start, when
	congestion and/or send windows are small. However, suppose that we can
	send N segments and already sent some complete TLS records in N - K
	segments. We can send only K segments, which might be less than the size
	of complete TLS record. We'll send the rest of TCP segments when ACKs
	for the first sent segments arrive. Since we can not start to decryp a
	TLS record until it's fully read, an additional delays may apper on
	TLS processing.

	With this option TLS encrypts data in sk_write_xmit() callback called by
	tcp_write_xmit(), when we know precisely how much data we can send.

	If unsure, say N.

config TLS_HANDSHAKE
	bool "Transport Layer Security handshake protocol support"
	depends on TLS && TLS_SOFTIRQ
	select CRYPTO_HMAC
	select CRYPTO_SHA1
	select CRYPTO_SHA1_SSSE3
	default n
	help
	Enable kernel support for TLS handshakes.

	If unsure, say N.
```

## security/tempesta/Kconfig
```kconfig
config SECURITY_TEMPESTA
	bool "Tempesta FW Support"
	depends on SECURITY && NET && INET
	select TLS_HANDSHAKE
	select SECURITY_NETWORK
	select RPS
	select CRYPTO
	select CRYPTO_HMAC
	select CRYPTO_SHA1
	select CRYPTO_SHA1_SSSE3
	select CRYPTO_GCM
	select CRYPTO_CCM
	default y
	help
	  This selects Tempesta FW security module.
	  Further information may be found at https://github.com/natsys/tempesta
	  If you are unsure how to answer this question, answer N.
```
